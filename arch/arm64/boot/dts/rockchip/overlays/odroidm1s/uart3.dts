/dts-v1/;
/plugin/;

#include "../../rk3568-pinctrl.dtsi"

/ {
	fragment@0 {
		// uart7 aliased with serial3.
		target = <&uart7>;

		__overlay__ {
			status = "okay";

			dma-names = "tx", "rx";
			pinctrl-0 = <&uart7m0_xfer>;
		};
	};
};
